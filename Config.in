## Config.in
```kconfig
source "$BR2_EXTERNAL_LKDEV_PATH/package/will-it-scale/Config.in"
source "$BR2_EXTERNAL_LKDEV_PATH/package/safeside/Config.in"
```

## configs/power9le_defconfig
```kconfig
BR2_powerpc64le=y
# XXX bump this to power9?
BR2_powerpc_power8=y

BR2_GLOBAL_PATCH_DIR="$(BR2_EXTERNAL_LKDEV_PATH)/patches/"
BR2_PACKAGE_OVERRIDE_FILE="$(BR2_EXTERNAL_LKDEV_PATH)/overrides.mk"

BR2_TARGET_GENERIC_HOSTNAME="lkdev"
BR2_TARGET_GENERIC_ROOT_PASSWD="lkdev"
BR2_TARGET_ROOTFS_CPIO=y
BR2_TARGET_ROOTFS_CPIO_XZ=y
BR2_ROOTFS_OVERLAY="$(BR2_EXTERNAL_LKDEV_PATH)/overlay"
BR2_SYSTEM_DEFAULT_PATH="/bin:/sbin:/usr/bin:/usr/sbin:/usr/bin/lkdev"

BR2_PACKAGE_WILL_IT_SCALE=y
BR2_PACKAGE_SAFESIDE=y
```

## package/safeside/Config.in
```kconfig
config BR2_PACKAGE_SAFESIDE
	bool "safeside"
	select BR2_INSTALL_LIBSTDCPP
	help
	  The Google Safeside project provides simple spectre and meltdown
	  exploit demos.

	  https://github.com/google/safeside
```

## package/will-it-scale/Config.in
```kconfig
config BR2_PACKAGE_WILL_IT_SCALE
	bool "will-it-scale"
	select BR2_PACKAGE_HWLOC
	help
	  Will It Scale takes a testcase and runs it from 1 through n parallel
	  copies to see if the testcase will scale. It builds both a process
	  and threads based test in order to see any differences between the
	  two.

	  https://github.com/antonblanchard/will-it-scale
```
